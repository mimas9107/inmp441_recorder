## main/Kconfig.projbuild
```kconfig
menu "Inmp441 Recorder Configuration"

    config WIFI_SSID
        string "WiFi SSID"
        default "MySSID"
        help
            SSID of the AP to connect to.

    config WIFI_PASSWORD
        string "WiFi Password"
        default "MyPassword"
        help
            Password of the AP.

    config SERVER_URL
        string "Server URL"
        default "http://192.168.1.100:5000/upload"
        help
            The URL to POST the audio file to.

    config I2S_BCK_GPIO
        int "I2S Bit Clock Pin"
        default 32

    config I2S_WS_GPIO
        int "I2S Word Select Pin"
        default 25

    config I2S_DIN_GPIO
        int "I2S Data In Pin"
        default 33

    config SAMPLE_RATE
        int "Sample Rate"
        default 16000

    config RECORD_SECONDS
        int "Record Seconds"
        default 3

    config VAD_THRESHOLD
        int "VAD RMS Threshold"
        default 1000
        help
            RMS energy threshold to trigger recording.

endmenu
```
